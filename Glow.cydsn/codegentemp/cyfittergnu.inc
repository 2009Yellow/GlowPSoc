.ifndef INCLUDED_CYFITTERGNU_INC
.set INCLUDED_CYFITTERGNU_INC, 1
.include "cydevicegnu.inc"
.include "cydevicegnu_trm.inc"

/* ADC_SAR_1_ADC_SAR */
.set ADC_SAR_1_ADC_SAR__CLK, CYREG_SAR1_CLK
.set ADC_SAR_1_ADC_SAR__CSR0, CYREG_SAR1_CSR0
.set ADC_SAR_1_ADC_SAR__CSR1, CYREG_SAR1_CSR1
.set ADC_SAR_1_ADC_SAR__CSR2, CYREG_SAR1_CSR2
.set ADC_SAR_1_ADC_SAR__CSR3, CYREG_SAR1_CSR3
.set ADC_SAR_1_ADC_SAR__CSR4, CYREG_SAR1_CSR4
.set ADC_SAR_1_ADC_SAR__CSR5, CYREG_SAR1_CSR5
.set ADC_SAR_1_ADC_SAR__CSR6, CYREG_SAR1_CSR6
.set ADC_SAR_1_ADC_SAR__PM_ACT_CFG, CYREG_PM_ACT_CFG11
.set ADC_SAR_1_ADC_SAR__PM_ACT_MSK, 0x02
.set ADC_SAR_1_ADC_SAR__PM_STBY_CFG, CYREG_PM_STBY_CFG11
.set ADC_SAR_1_ADC_SAR__PM_STBY_MSK, 0x02
.set ADC_SAR_1_ADC_SAR__SW0, CYREG_SAR1_SW0
.set ADC_SAR_1_ADC_SAR__SW2, CYREG_SAR1_SW2
.set ADC_SAR_1_ADC_SAR__SW3, CYREG_SAR1_SW3
.set ADC_SAR_1_ADC_SAR__SW4, CYREG_SAR1_SW4
.set ADC_SAR_1_ADC_SAR__SW6, CYREG_SAR1_SW6
.set ADC_SAR_1_ADC_SAR__TR0, CYREG_SAR1_TR0
.set ADC_SAR_1_ADC_SAR__WRK0, CYREG_SAR1_WRK0
.set ADC_SAR_1_ADC_SAR__WRK1, CYREG_SAR1_WRK1

/* ADC_SAR_1_theACLK */
.set ADC_SAR_1_theACLK__CFG0, CYREG_CLKDIST_ACFG0_CFG0
.set ADC_SAR_1_theACLK__CFG1, CYREG_CLKDIST_ACFG0_CFG1
.set ADC_SAR_1_theACLK__CFG2, CYREG_CLKDIST_ACFG0_CFG2
.set ADC_SAR_1_theACLK__CFG2_SRC_SEL_MASK, 0x07
.set ADC_SAR_1_theACLK__CFG3, CYREG_CLKDIST_ACFG0_CFG3
.set ADC_SAR_1_theACLK__CFG3_PHASE_DLY_MASK, 0x0F
.set ADC_SAR_1_theACLK__INDEX, 0x00
.set ADC_SAR_1_theACLK__PM_ACT_CFG, CYREG_PM_ACT_CFG1
.set ADC_SAR_1_theACLK__PM_ACT_MSK, 0x01
.set ADC_SAR_1_theACLK__PM_STBY_CFG, CYREG_PM_STBY_CFG1
.set ADC_SAR_1_theACLK__PM_STBY_MSK, 0x01

/* ADC_SAR_1_Bypass */
.set ADC_SAR_1_Bypass__0__MASK, 0x04
.set ADC_SAR_1_Bypass__0__PC, CYREG_PRT0_PC2
.set ADC_SAR_1_Bypass__0__PORT, 0
.set ADC_SAR_1_Bypass__0__SHIFT, 2
.set ADC_SAR_1_Bypass__AG, CYREG_PRT0_AG
.set ADC_SAR_1_Bypass__AMUX, CYREG_PRT0_AMUX
.set ADC_SAR_1_Bypass__BIE, CYREG_PRT0_BIE
.set ADC_SAR_1_Bypass__BIT_MASK, CYREG_PRT0_BIT_MASK
.set ADC_SAR_1_Bypass__BYP, CYREG_PRT0_BYP
.set ADC_SAR_1_Bypass__CTL, CYREG_PRT0_CTL
.set ADC_SAR_1_Bypass__DM0, CYREG_PRT0_DM0
.set ADC_SAR_1_Bypass__DM1, CYREG_PRT0_DM1
.set ADC_SAR_1_Bypass__DM2, CYREG_PRT0_DM2
.set ADC_SAR_1_Bypass__DR, CYREG_PRT0_DR
.set ADC_SAR_1_Bypass__INP_DIS, CYREG_PRT0_INP_DIS
.set ADC_SAR_1_Bypass__LCD_COM_SEG, CYREG_PRT0_LCD_COM_SEG
.set ADC_SAR_1_Bypass__LCD_EN, CYREG_PRT0_LCD_EN
.set ADC_SAR_1_Bypass__MASK, 0x04
.set ADC_SAR_1_Bypass__PORT, 0
.set ADC_SAR_1_Bypass__PRT, CYREG_PRT0_PRT
.set ADC_SAR_1_Bypass__PRTDSI__CAPS_SEL, CYREG_PRT0_CAPS_SEL
.set ADC_SAR_1_Bypass__PRTDSI__DBL_SYNC_IN, CYREG_PRT0_DBL_SYNC_IN
.set ADC_SAR_1_Bypass__PRTDSI__OE_SEL0, CYREG_PRT0_OE_SEL0
.set ADC_SAR_1_Bypass__PRTDSI__OE_SEL1, CYREG_PRT0_OE_SEL1
.set ADC_SAR_1_Bypass__PRTDSI__OUT_SEL0, CYREG_PRT0_OUT_SEL0
.set ADC_SAR_1_Bypass__PRTDSI__OUT_SEL1, CYREG_PRT0_OUT_SEL1
.set ADC_SAR_1_Bypass__PRTDSI__SYNC_OUT, CYREG_PRT0_SYNC_OUT
.set ADC_SAR_1_Bypass__PS, CYREG_PRT0_PS
.set ADC_SAR_1_Bypass__SHIFT, 2
.set ADC_SAR_1_Bypass__SLW, CYREG_PRT0_SLW

/* IDAC8_REF_viDAC8 */
.set IDAC8_REF_viDAC8__CR0, CYREG_DAC2_CR0
.set IDAC8_REF_viDAC8__CR1, CYREG_DAC2_CR1
.set IDAC8_REF_viDAC8__D, CYREG_DAC2_D
.set IDAC8_REF_viDAC8__PM_ACT_CFG, CYREG_PM_ACT_CFG8
.set IDAC8_REF_viDAC8__PM_ACT_MSK, 0x04
.set IDAC8_REF_viDAC8__PM_STBY_CFG, CYREG_PM_STBY_CFG8
.set IDAC8_REF_viDAC8__PM_STBY_MSK, 0x04
.set IDAC8_REF_viDAC8__STROBE, CYREG_DAC2_STROBE
.set IDAC8_REF_viDAC8__SW0, CYREG_DAC2_SW0
.set IDAC8_REF_viDAC8__SW2, CYREG_DAC2_SW2
.set IDAC8_REF_viDAC8__SW3, CYREG_DAC2_SW3
.set IDAC8_REF_viDAC8__SW4, CYREG_DAC2_SW4
.set IDAC8_REF_viDAC8__TR, CYREG_DAC2_TR
.set IDAC8_REF_viDAC8__TRIM__M1, CYREG_FLSHID_CUST_TABLES_DAC2_M1
.set IDAC8_REF_viDAC8__TRIM__M2, CYREG_FLSHID_CUST_TABLES_DAC2_M2
.set IDAC8_REF_viDAC8__TRIM__M3, CYREG_FLSHID_CUST_TABLES_DAC2_M3
.set IDAC8_REF_viDAC8__TRIM__M4, CYREG_FLSHID_CUST_TABLES_DAC2_M4
.set IDAC8_REF_viDAC8__TRIM__M5, CYREG_FLSHID_CUST_TABLES_DAC2_M5
.set IDAC8_REF_viDAC8__TRIM__M6, CYREG_FLSHID_CUST_TABLES_DAC2_M6
.set IDAC8_REF_viDAC8__TRIM__M7, CYREG_FLSHID_CUST_TABLES_DAC2_M7
.set IDAC8_REF_viDAC8__TRIM__M8, CYREG_FLSHID_CUST_TABLES_DAC2_M8
.set IDAC8_REF_viDAC8__TST, CYREG_DAC2_TST

/* VDAC8_REF_viDAC8 */
.set VDAC8_REF_viDAC8__CR0, CYREG_DAC1_CR0
.set VDAC8_REF_viDAC8__CR1, CYREG_DAC1_CR1
.set VDAC8_REF_viDAC8__D, CYREG_DAC1_D
.set VDAC8_REF_viDAC8__PM_ACT_CFG, CYREG_PM_ACT_CFG8
.set VDAC8_REF_viDAC8__PM_ACT_MSK, 0x02
.set VDAC8_REF_viDAC8__PM_STBY_CFG, CYREG_PM_STBY_CFG8
.set VDAC8_REF_viDAC8__PM_STBY_MSK, 0x02
.set VDAC8_REF_viDAC8__STROBE, CYREG_DAC1_STROBE
.set VDAC8_REF_viDAC8__SW0, CYREG_DAC1_SW0
.set VDAC8_REF_viDAC8__SW2, CYREG_DAC1_SW2
.set VDAC8_REF_viDAC8__SW3, CYREG_DAC1_SW3
.set VDAC8_REF_viDAC8__SW4, CYREG_DAC1_SW4
.set VDAC8_REF_viDAC8__TR, CYREG_DAC1_TR
.set VDAC8_REF_viDAC8__TRIM__M1, CYREG_FLSHID_CUST_TABLES_DAC1_M1
.set VDAC8_REF_viDAC8__TRIM__M2, CYREG_FLSHID_CUST_TABLES_DAC1_M2
.set VDAC8_REF_viDAC8__TRIM__M3, CYREG_FLSHID_CUST_TABLES_DAC1_M3
.set VDAC8_REF_viDAC8__TRIM__M4, CYREG_FLSHID_CUST_TABLES_DAC1_M4
.set VDAC8_REF_viDAC8__TRIM__M5, CYREG_FLSHID_CUST_TABLES_DAC1_M5
.set VDAC8_REF_viDAC8__TRIM__M6, CYREG_FLSHID_CUST_TABLES_DAC1_M6
.set VDAC8_REF_viDAC8__TRIM__M7, CYREG_FLSHID_CUST_TABLES_DAC1_M7
.set VDAC8_REF_viDAC8__TRIM__M8, CYREG_FLSHID_CUST_TABLES_DAC1_M8
.set VDAC8_REF_viDAC8__TST, CYREG_DAC1_TST

/* ADC_SAR_1_IRQ */
.set ADC_SAR_1_IRQ__INTC_CLR_EN_REG, CYREG_NVIC_CLRENA0
.set ADC_SAR_1_IRQ__INTC_CLR_PD_REG, CYREG_NVIC_CLRPEND0
.set ADC_SAR_1_IRQ__INTC_MASK, 0x01
.set ADC_SAR_1_IRQ__INTC_NUMBER, 0
.set ADC_SAR_1_IRQ__INTC_PRIOR_NUM, 7
.set ADC_SAR_1_IRQ__INTC_PRIOR_REG, CYREG_NVIC_PRI_0
.set ADC_SAR_1_IRQ__INTC_SET_EN_REG, CYREG_NVIC_SETENA0
.set ADC_SAR_1_IRQ__INTC_SET_PD_REG, CYREG_NVIC_SETPEND0

/* UART_IntClock */
.set UART_IntClock__CFG0, CYREG_CLKDIST_DCFG0_CFG0
.set UART_IntClock__CFG1, CYREG_CLKDIST_DCFG0_CFG1
.set UART_IntClock__CFG2, CYREG_CLKDIST_DCFG0_CFG2
.set UART_IntClock__CFG2_SRC_SEL_MASK, 0x07
.set UART_IntClock__INDEX, 0x00
.set UART_IntClock__PM_ACT_CFG, CYREG_PM_ACT_CFG2
.set UART_IntClock__PM_ACT_MSK, 0x01
.set UART_IntClock__PM_STBY_CFG, CYREG_PM_STBY_CFG2
.set UART_IntClock__PM_STBY_MSK, 0x01

/* LCD_LCDPort */
.set LCD_LCDPort__0__MASK, 0x01
.set LCD_LCDPort__0__PC, CYREG_PRT2_PC0
.set LCD_LCDPort__0__PORT, 2
.set LCD_LCDPort__0__SHIFT, 0
.set LCD_LCDPort__1__MASK, 0x02
.set LCD_LCDPort__1__PC, CYREG_PRT2_PC1
.set LCD_LCDPort__1__PORT, 2
.set LCD_LCDPort__1__SHIFT, 1
.set LCD_LCDPort__2__MASK, 0x04
.set LCD_LCDPort__2__PC, CYREG_PRT2_PC2
.set LCD_LCDPort__2__PORT, 2
.set LCD_LCDPort__2__SHIFT, 2
.set LCD_LCDPort__3__MASK, 0x08
.set LCD_LCDPort__3__PC, CYREG_PRT2_PC3
.set LCD_LCDPort__3__PORT, 2
.set LCD_LCDPort__3__SHIFT, 3
.set LCD_LCDPort__4__MASK, 0x10
.set LCD_LCDPort__4__PC, CYREG_PRT2_PC4
.set LCD_LCDPort__4__PORT, 2
.set LCD_LCDPort__4__SHIFT, 4
.set LCD_LCDPort__5__MASK, 0x20
.set LCD_LCDPort__5__PC, CYREG_PRT2_PC5
.set LCD_LCDPort__5__PORT, 2
.set LCD_LCDPort__5__SHIFT, 5
.set LCD_LCDPort__6__MASK, 0x40
.set LCD_LCDPort__6__PC, CYREG_PRT2_PC6
.set LCD_LCDPort__6__PORT, 2
.set LCD_LCDPort__6__SHIFT, 6
.set LCD_LCDPort__AG, CYREG_PRT2_AG
.set LCD_LCDPort__AMUX, CYREG_PRT2_AMUX
.set LCD_LCDPort__BIE, CYREG_PRT2_BIE
.set LCD_LCDPort__BIT_MASK, CYREG_PRT2_BIT_MASK
.set LCD_LCDPort__BYP, CYREG_PRT2_BYP
.set LCD_LCDPort__CTL, CYREG_PRT2_CTL
.set LCD_LCDPort__DM0, CYREG_PRT2_DM0
.set LCD_LCDPort__DM1, CYREG_PRT2_DM1
.set LCD_LCDPort__DM2, CYREG_PRT2_DM2
.set LCD_LCDPort__DR, CYREG_PRT2_DR
.set LCD_LCDPort__INP_DIS, CYREG_PRT2_INP_DIS
.set LCD_LCDPort__LCD_COM_SEG, CYREG_PRT2_LCD_COM_SEG
.set LCD_LCDPort__LCD_EN, CYREG_PRT2_LCD_EN
.set LCD_LCDPort__MASK, 0x7F
.set LCD_LCDPort__PORT, 2
.set LCD_LCDPort__PRT, CYREG_PRT2_PRT
.set LCD_LCDPort__PRTDSI__CAPS_SEL, CYREG_PRT2_CAPS_SEL
.set LCD_LCDPort__PRTDSI__DBL_SYNC_IN, CYREG_PRT2_DBL_SYNC_IN
.set LCD_LCDPort__PRTDSI__OE_SEL0, CYREG_PRT2_OE_SEL0
.set LCD_LCDPort__PRTDSI__OE_SEL1, CYREG_PRT2_OE_SEL1
.set LCD_LCDPort__PRTDSI__OUT_SEL0, CYREG_PRT2_OUT_SEL0
.set LCD_LCDPort__PRTDSI__OUT_SEL1, CYREG_PRT2_OUT_SEL1
.set LCD_LCDPort__PRTDSI__SYNC_OUT, CYREG_PRT2_SYNC_OUT
.set LCD_LCDPort__PS, CYREG_PRT2_PS
.set LCD_LCDPort__SHIFT, 0
.set LCD_LCDPort__SLW, CYREG_PRT2_SLW

/* PGA_GAIN_SC */
.set PGA_GAIN_SC__BST, CYREG_SC1_BST
.set PGA_GAIN_SC__CLK, CYREG_SC1_CLK
.set PGA_GAIN_SC__CMPINV, CYREG_SC_CMPINV
.set PGA_GAIN_SC__CPTR, CYREG_SC_CPTR
.set PGA_GAIN_SC__CR0, CYREG_SC1_CR0
.set PGA_GAIN_SC__CR1, CYREG_SC1_CR1
.set PGA_GAIN_SC__CR2, CYREG_SC1_CR2
.set PGA_GAIN_SC__MSK, CYREG_SC_MSK
.set PGA_GAIN_SC__PM_ACT_CFG, CYREG_PM_ACT_CFG9
.set PGA_GAIN_SC__PM_ACT_MSK, 0x02
.set PGA_GAIN_SC__PM_STBY_CFG, CYREG_PM_STBY_CFG9
.set PGA_GAIN_SC__PM_STBY_MSK, 0x02
.set PGA_GAIN_SC__SR, CYREG_SC_SR
.set PGA_GAIN_SC__SW0, CYREG_SC1_SW0
.set PGA_GAIN_SC__SW10, CYREG_SC1_SW10
.set PGA_GAIN_SC__SW2, CYREG_SC1_SW2
.set PGA_GAIN_SC__SW3, CYREG_SC1_SW3
.set PGA_GAIN_SC__SW4, CYREG_SC1_SW4
.set PGA_GAIN_SC__SW6, CYREG_SC1_SW6
.set PGA_GAIN_SC__SW7, CYREG_SC1_SW7
.set PGA_GAIN_SC__SW8, CYREG_SC1_SW8
.set PGA_GAIN_SC__WRK1, CYREG_SC_WRK1

/* PGA_REF_SC */
.set PGA_REF_SC__BST, CYREG_SC3_BST
.set PGA_REF_SC__CLK, CYREG_SC3_CLK
.set PGA_REF_SC__CMPINV, CYREG_SC_CMPINV
.set PGA_REF_SC__CPTR, CYREG_SC_CPTR
.set PGA_REF_SC__CR0, CYREG_SC3_CR0
.set PGA_REF_SC__CR1, CYREG_SC3_CR1
.set PGA_REF_SC__CR2, CYREG_SC3_CR2
.set PGA_REF_SC__MSK, CYREG_SC_MSK
.set PGA_REF_SC__PM_ACT_CFG, CYREG_PM_ACT_CFG9
.set PGA_REF_SC__PM_ACT_MSK, 0x08
.set PGA_REF_SC__PM_STBY_CFG, CYREG_PM_STBY_CFG9
.set PGA_REF_SC__PM_STBY_MSK, 0x08
.set PGA_REF_SC__SR, CYREG_SC_SR
.set PGA_REF_SC__SW0, CYREG_SC3_SW0
.set PGA_REF_SC__SW10, CYREG_SC3_SW10
.set PGA_REF_SC__SW2, CYREG_SC3_SW2
.set PGA_REF_SC__SW3, CYREG_SC3_SW3
.set PGA_REF_SC__SW4, CYREG_SC3_SW4
.set PGA_REF_SC__SW6, CYREG_SC3_SW6
.set PGA_REF_SC__SW7, CYREG_SC3_SW7
.set PGA_REF_SC__SW8, CYREG_SC3_SW8
.set PGA_REF_SC__WRK1, CYREG_SC_WRK1

/* UART_BUART */
.set UART_BUART_sRX_RxBitCounter_ST__16BIT_STATUS_AUX_CTL_REG, CYREG_B0_UDB11_12_ACTL
.set UART_BUART_sRX_RxBitCounter_ST__16BIT_STATUS_REG, CYREG_B0_UDB11_12_ST
.set UART_BUART_sRX_RxBitCounter_ST__MASK_REG, CYREG_B0_UDB11_MSK
.set UART_BUART_sRX_RxBitCounter_ST__MASK_ST_AUX_CTL_REG, CYREG_B0_UDB11_MSK_ACTL
.set UART_BUART_sRX_RxBitCounter_ST__PER_ST_AUX_CTL_REG, CYREG_B0_UDB11_MSK_ACTL
.set UART_BUART_sRX_RxBitCounter_ST__STATUS_AUX_CTL_REG, CYREG_B0_UDB11_ACTL
.set UART_BUART_sRX_RxBitCounter_ST__STATUS_CNT_REG, CYREG_B0_UDB11_ST_CTL
.set UART_BUART_sRX_RxBitCounter_ST__STATUS_CONTROL_REG, CYREG_B0_UDB11_ST_CTL
.set UART_BUART_sRX_RxBitCounter_ST__STATUS_REG, CYREG_B0_UDB11_ST
.set UART_BUART_sRX_RxBitCounter__16BIT_CONTROL_AUX_CTL_REG, CYREG_B0_UDB11_12_ACTL
.set UART_BUART_sRX_RxBitCounter__16BIT_CONTROL_CONTROL_REG, CYREG_B0_UDB11_12_CTL
.set UART_BUART_sRX_RxBitCounter__16BIT_CONTROL_COUNT_REG, CYREG_B0_UDB11_12_CTL
.set UART_BUART_sRX_RxBitCounter__16BIT_COUNT_CONTROL_REG, CYREG_B0_UDB11_12_CTL
.set UART_BUART_sRX_RxBitCounter__16BIT_COUNT_COUNT_REG, CYREG_B0_UDB11_12_CTL
.set UART_BUART_sRX_RxBitCounter__16BIT_MASK_MASK_REG, CYREG_B0_UDB11_12_MSK
.set UART_BUART_sRX_RxBitCounter__16BIT_MASK_PERIOD_REG, CYREG_B0_UDB11_12_MSK
.set UART_BUART_sRX_RxBitCounter__16BIT_PERIOD_MASK_REG, CYREG_B0_UDB11_12_MSK
.set UART_BUART_sRX_RxBitCounter__16BIT_PERIOD_PERIOD_REG, CYREG_B0_UDB11_12_MSK
.set UART_BUART_sRX_RxBitCounter__CONTROL_AUX_CTL_REG, CYREG_B0_UDB11_ACTL
.set UART_BUART_sRX_RxBitCounter__CONTROL_REG, CYREG_B0_UDB11_CTL
.set UART_BUART_sRX_RxBitCounter__CONTROL_ST_REG, CYREG_B0_UDB11_ST_CTL
.set UART_BUART_sRX_RxBitCounter__COUNT_REG, CYREG_B0_UDB11_CTL
.set UART_BUART_sRX_RxBitCounter__COUNT_ST_REG, CYREG_B0_UDB11_ST_CTL
.set UART_BUART_sRX_RxBitCounter__MASK_CTL_AUX_CTL_REG, CYREG_B0_UDB11_MSK_ACTL
.set UART_BUART_sRX_RxBitCounter__PERIOD_REG, CYREG_B0_UDB11_MSK
.set UART_BUART_sRX_RxBitCounter__PER_CTL_AUX_CTL_REG, CYREG_B0_UDB11_MSK_ACTL
.set UART_BUART_sRX_RxShifter_u0__16BIT_A0_REG, CYREG_B0_UDB13_14_A0
.set UART_BUART_sRX_RxShifter_u0__16BIT_A1_REG, CYREG_B0_UDB13_14_A1
.set UART_BUART_sRX_RxShifter_u0__16BIT_D0_REG, CYREG_B0_UDB13_14_D0
.set UART_BUART_sRX_RxShifter_u0__16BIT_D1_REG, CYREG_B0_UDB13_14_D1
.set UART_BUART_sRX_RxShifter_u0__16BIT_DP_AUX_CTL_REG, CYREG_B0_UDB13_14_ACTL
.set UART_BUART_sRX_RxShifter_u0__16BIT_F0_REG, CYREG_B0_UDB13_14_F0
.set UART_BUART_sRX_RxShifter_u0__16BIT_F1_REG, CYREG_B0_UDB13_14_F1
.set UART_BUART_sRX_RxShifter_u0__A0_A1_REG, CYREG_B0_UDB13_A0_A1
.set UART_BUART_sRX_RxShifter_u0__A0_REG, CYREG_B0_UDB13_A0
.set UART_BUART_sRX_RxShifter_u0__A1_REG, CYREG_B0_UDB13_A1
.set UART_BUART_sRX_RxShifter_u0__D0_D1_REG, CYREG_B0_UDB13_D0_D1
.set UART_BUART_sRX_RxShifter_u0__D0_REG, CYREG_B0_UDB13_D0
.set UART_BUART_sRX_RxShifter_u0__D1_REG, CYREG_B0_UDB13_D1
.set UART_BUART_sRX_RxShifter_u0__DP_AUX_CTL_REG, CYREG_B0_UDB13_ACTL
.set UART_BUART_sRX_RxShifter_u0__F0_F1_REG, CYREG_B0_UDB13_F0_F1
.set UART_BUART_sRX_RxShifter_u0__F0_REG, CYREG_B0_UDB13_F0
.set UART_BUART_sRX_RxShifter_u0__F1_REG, CYREG_B0_UDB13_F1
.set UART_BUART_sRX_RxSts__16BIT_STATUS_AUX_CTL_REG, CYREG_B0_UDB13_14_ACTL
.set UART_BUART_sRX_RxSts__16BIT_STATUS_REG, CYREG_B0_UDB13_14_ST
.set UART_BUART_sRX_RxSts__3__MASK, 0x08
.set UART_BUART_sRX_RxSts__3__POS, 3
.set UART_BUART_sRX_RxSts__4__MASK, 0x10
.set UART_BUART_sRX_RxSts__4__POS, 4
.set UART_BUART_sRX_RxSts__5__MASK, 0x20
.set UART_BUART_sRX_RxSts__5__POS, 5
.set UART_BUART_sRX_RxSts__MASK, 0x38
.set UART_BUART_sRX_RxSts__MASK_REG, CYREG_B0_UDB13_MSK
.set UART_BUART_sRX_RxSts__STATUS_AUX_CTL_REG, CYREG_B0_UDB13_ACTL
.set UART_BUART_sRX_RxSts__STATUS_REG, CYREG_B0_UDB13_ST
.set UART_BUART_sTX_TxShifter_u0__16BIT_A0_REG, CYREG_B0_UDB14_15_A0
.set UART_BUART_sTX_TxShifter_u0__16BIT_A1_REG, CYREG_B0_UDB14_15_A1
.set UART_BUART_sTX_TxShifter_u0__16BIT_D0_REG, CYREG_B0_UDB14_15_D0
.set UART_BUART_sTX_TxShifter_u0__16BIT_D1_REG, CYREG_B0_UDB14_15_D1
.set UART_BUART_sTX_TxShifter_u0__16BIT_DP_AUX_CTL_REG, CYREG_B0_UDB14_15_ACTL
.set UART_BUART_sTX_TxShifter_u0__16BIT_F0_REG, CYREG_B0_UDB14_15_F0
.set UART_BUART_sTX_TxShifter_u0__16BIT_F1_REG, CYREG_B0_UDB14_15_F1
.set UART_BUART_sTX_TxShifter_u0__A0_A1_REG, CYREG_B0_UDB14_A0_A1
.set UART_BUART_sTX_TxShifter_u0__A0_REG, CYREG_B0_UDB14_A0
.set UART_BUART_sTX_TxShifter_u0__A1_REG, CYREG_B0_UDB14_A1
.set UART_BUART_sTX_TxShifter_u0__D0_D1_REG, CYREG_B0_UDB14_D0_D1
.set UART_BUART_sTX_TxShifter_u0__D0_REG, CYREG_B0_UDB14_D0
.set UART_BUART_sTX_TxShifter_u0__D1_REG, CYREG_B0_UDB14_D1
.set UART_BUART_sTX_TxShifter_u0__DP_AUX_CTL_REG, CYREG_B0_UDB14_ACTL
.set UART_BUART_sTX_TxShifter_u0__F0_F1_REG, CYREG_B0_UDB14_F0_F1
.set UART_BUART_sTX_TxShifter_u0__F0_REG, CYREG_B0_UDB14_F0
.set UART_BUART_sTX_TxShifter_u0__F1_REG, CYREG_B0_UDB14_F1
.set UART_BUART_sTX_TxSts__0__MASK, 0x01
.set UART_BUART_sTX_TxSts__0__POS, 0
.set UART_BUART_sTX_TxSts__16BIT_STATUS_AUX_CTL_REG, CYREG_B0_UDB14_15_ACTL
.set UART_BUART_sTX_TxSts__16BIT_STATUS_REG, CYREG_B0_UDB14_15_ST
.set UART_BUART_sTX_TxSts__1__MASK, 0x02
.set UART_BUART_sTX_TxSts__1__POS, 1
.set UART_BUART_sTX_TxSts__2__MASK, 0x04
.set UART_BUART_sTX_TxSts__2__POS, 2
.set UART_BUART_sTX_TxSts__3__MASK, 0x08
.set UART_BUART_sTX_TxSts__3__POS, 3
.set UART_BUART_sTX_TxSts__MASK, 0x0F
.set UART_BUART_sTX_TxSts__MASK_REG, CYREG_B0_UDB14_MSK
.set UART_BUART_sTX_TxSts__STATUS_AUX_CTL_REG, CYREG_B0_UDB14_ACTL
.set UART_BUART_sTX_TxSts__STATUS_REG, CYREG_B0_UDB14_ST
.set UART_BUART_sTX_sCLOCK_TxBitClkGen__A0_A1_REG, CYREG_B0_UDB15_A0_A1
.set UART_BUART_sTX_sCLOCK_TxBitClkGen__A0_REG, CYREG_B0_UDB15_A0
.set UART_BUART_sTX_sCLOCK_TxBitClkGen__A1_REG, CYREG_B0_UDB15_A1
.set UART_BUART_sTX_sCLOCK_TxBitClkGen__D0_D1_REG, CYREG_B0_UDB15_D0_D1
.set UART_BUART_sTX_sCLOCK_TxBitClkGen__D0_REG, CYREG_B0_UDB15_D0
.set UART_BUART_sTX_sCLOCK_TxBitClkGen__D1_REG, CYREG_B0_UDB15_D1
.set UART_BUART_sTX_sCLOCK_TxBitClkGen__DP_AUX_CTL_REG, CYREG_B0_UDB15_ACTL
.set UART_BUART_sTX_sCLOCK_TxBitClkGen__F0_F1_REG, CYREG_B0_UDB15_F0_F1
.set UART_BUART_sTX_sCLOCK_TxBitClkGen__F0_REG, CYREG_B0_UDB15_F0
.set UART_BUART_sTX_sCLOCK_TxBitClkGen__F1_REG, CYREG_B0_UDB15_F1

/* BOTTOM_1 */
.set BOTTOM_1__0__MASK, 0x80
.set BOTTOM_1__0__PC, CYREG_PRT4_PC7
.set BOTTOM_1__0__PORT, 4
.set BOTTOM_1__0__SHIFT, 7
.set BOTTOM_1__AG, CYREG_PRT4_AG
.set BOTTOM_1__AMUX, CYREG_PRT4_AMUX
.set BOTTOM_1__BIE, CYREG_PRT4_BIE
.set BOTTOM_1__BIT_MASK, CYREG_PRT4_BIT_MASK
.set BOTTOM_1__BYP, CYREG_PRT4_BYP
.set BOTTOM_1__CTL, CYREG_PRT4_CTL
.set BOTTOM_1__DM0, CYREG_PRT4_DM0
.set BOTTOM_1__DM1, CYREG_PRT4_DM1
.set BOTTOM_1__DM2, CYREG_PRT4_DM2
.set BOTTOM_1__DR, CYREG_PRT4_DR
.set BOTTOM_1__INP_DIS, CYREG_PRT4_INP_DIS
.set BOTTOM_1__LCD_COM_SEG, CYREG_PRT4_LCD_COM_SEG
.set BOTTOM_1__LCD_EN, CYREG_PRT4_LCD_EN
.set BOTTOM_1__MASK, 0x80
.set BOTTOM_1__PORT, 4
.set BOTTOM_1__PRT, CYREG_PRT4_PRT
.set BOTTOM_1__PRTDSI__CAPS_SEL, CYREG_PRT4_CAPS_SEL
.set BOTTOM_1__PRTDSI__DBL_SYNC_IN, CYREG_PRT4_DBL_SYNC_IN
.set BOTTOM_1__PRTDSI__OE_SEL0, CYREG_PRT4_OE_SEL0
.set BOTTOM_1__PRTDSI__OE_SEL1, CYREG_PRT4_OE_SEL1
.set BOTTOM_1__PRTDSI__OUT_SEL0, CYREG_PRT4_OUT_SEL0
.set BOTTOM_1__PRTDSI__OUT_SEL1, CYREG_PRT4_OUT_SEL1
.set BOTTOM_1__PRTDSI__SYNC_OUT, CYREG_PRT4_SYNC_OUT
.set BOTTOM_1__PS, CYREG_PRT4_PS
.set BOTTOM_1__SHIFT, 7
.set BOTTOM_1__SLW, CYREG_PRT4_SLW

/* BOTTOM_2 */
.set BOTTOM_2__0__MASK, 0x01
.set BOTTOM_2__0__PC, CYREG_PRT4_PC0
.set BOTTOM_2__0__PORT, 4
.set BOTTOM_2__0__SHIFT, 0
.set BOTTOM_2__AG, CYREG_PRT4_AG
.set BOTTOM_2__AMUX, CYREG_PRT4_AMUX
.set BOTTOM_2__BIE, CYREG_PRT4_BIE
.set BOTTOM_2__BIT_MASK, CYREG_PRT4_BIT_MASK
.set BOTTOM_2__BYP, CYREG_PRT4_BYP
.set BOTTOM_2__CTL, CYREG_PRT4_CTL
.set BOTTOM_2__DM0, CYREG_PRT4_DM0
.set BOTTOM_2__DM1, CYREG_PRT4_DM1
.set BOTTOM_2__DM2, CYREG_PRT4_DM2
.set BOTTOM_2__DR, CYREG_PRT4_DR
.set BOTTOM_2__INP_DIS, CYREG_PRT4_INP_DIS
.set BOTTOM_2__LCD_COM_SEG, CYREG_PRT4_LCD_COM_SEG
.set BOTTOM_2__LCD_EN, CYREG_PRT4_LCD_EN
.set BOTTOM_2__MASK, 0x01
.set BOTTOM_2__PORT, 4
.set BOTTOM_2__PRT, CYREG_PRT4_PRT
.set BOTTOM_2__PRTDSI__CAPS_SEL, CYREG_PRT4_CAPS_SEL
.set BOTTOM_2__PRTDSI__DBL_SYNC_IN, CYREG_PRT4_DBL_SYNC_IN
.set BOTTOM_2__PRTDSI__OE_SEL0, CYREG_PRT4_OE_SEL0
.set BOTTOM_2__PRTDSI__OE_SEL1, CYREG_PRT4_OE_SEL1
.set BOTTOM_2__PRTDSI__OUT_SEL0, CYREG_PRT4_OUT_SEL0
.set BOTTOM_2__PRTDSI__OUT_SEL1, CYREG_PRT4_OUT_SEL1
.set BOTTOM_2__PRTDSI__SYNC_OUT, CYREG_PRT4_SYNC_OUT
.set BOTTOM_2__PS, CYREG_PRT4_PS
.set BOTTOM_2__SHIFT, 0
.set BOTTOM_2__SLW, CYREG_PRT4_SLW

/* BOTTOM_3 */
.set BOTTOM_3__0__MASK, 0x10
.set BOTTOM_3__0__PC, CYREG_PRT6_PC4
.set BOTTOM_3__0__PORT, 6
.set BOTTOM_3__0__SHIFT, 4
.set BOTTOM_3__AG, CYREG_PRT6_AG
.set BOTTOM_3__AMUX, CYREG_PRT6_AMUX
.set BOTTOM_3__BIE, CYREG_PRT6_BIE
.set BOTTOM_3__BIT_MASK, CYREG_PRT6_BIT_MASK
.set BOTTOM_3__BYP, CYREG_PRT6_BYP
.set BOTTOM_3__CTL, CYREG_PRT6_CTL
.set BOTTOM_3__DM0, CYREG_PRT6_DM0
.set BOTTOM_3__DM1, CYREG_PRT6_DM1
.set BOTTOM_3__DM2, CYREG_PRT6_DM2
.set BOTTOM_3__DR, CYREG_PRT6_DR
.set BOTTOM_3__INP_DIS, CYREG_PRT6_INP_DIS
.set BOTTOM_3__LCD_COM_SEG, CYREG_PRT6_LCD_COM_SEG
.set BOTTOM_3__LCD_EN, CYREG_PRT6_LCD_EN
.set BOTTOM_3__MASK, 0x10
.set BOTTOM_3__PORT, 6
.set BOTTOM_3__PRT, CYREG_PRT6_PRT
.set BOTTOM_3__PRTDSI__CAPS_SEL, CYREG_PRT6_CAPS_SEL
.set BOTTOM_3__PRTDSI__DBL_SYNC_IN, CYREG_PRT6_DBL_SYNC_IN
.set BOTTOM_3__PRTDSI__OE_SEL0, CYREG_PRT6_OE_SEL0
.set BOTTOM_3__PRTDSI__OE_SEL1, CYREG_PRT6_OE_SEL1
.set BOTTOM_3__PRTDSI__OUT_SEL0, CYREG_PRT6_OUT_SEL0
.set BOTTOM_3__PRTDSI__OUT_SEL1, CYREG_PRT6_OUT_SEL1
.set BOTTOM_3__PRTDSI__SYNC_OUT, CYREG_PRT6_SYNC_OUT
.set BOTTOM_3__PS, CYREG_PRT6_PS
.set BOTTOM_3__SHIFT, 4
.set BOTTOM_3__SLW, CYREG_PRT6_SLW

/* BOTTOM_4 */
.set BOTTOM_4__0__MASK, 0x08
.set BOTTOM_4__0__PC, CYREG_PRT6_PC3
.set BOTTOM_4__0__PORT, 6
.set BOTTOM_4__0__SHIFT, 3
.set BOTTOM_4__AG, CYREG_PRT6_AG
.set BOTTOM_4__AMUX, CYREG_PRT6_AMUX
.set BOTTOM_4__BIE, CYREG_PRT6_BIE
.set BOTTOM_4__BIT_MASK, CYREG_PRT6_BIT_MASK
.set BOTTOM_4__BYP, CYREG_PRT6_BYP
.set BOTTOM_4__CTL, CYREG_PRT6_CTL
.set BOTTOM_4__DM0, CYREG_PRT6_DM0
.set BOTTOM_4__DM1, CYREG_PRT6_DM1
.set BOTTOM_4__DM2, CYREG_PRT6_DM2
.set BOTTOM_4__DR, CYREG_PRT6_DR
.set BOTTOM_4__INP_DIS, CYREG_PRT6_INP_DIS
.set BOTTOM_4__LCD_COM_SEG, CYREG_PRT6_LCD_COM_SEG
.set BOTTOM_4__LCD_EN, CYREG_PRT6_LCD_EN
.set BOTTOM_4__MASK, 0x08
.set BOTTOM_4__PORT, 6
.set BOTTOM_4__PRT, CYREG_PRT6_PRT
.set BOTTOM_4__PRTDSI__CAPS_SEL, CYREG_PRT6_CAPS_SEL
.set BOTTOM_4__PRTDSI__DBL_SYNC_IN, CYREG_PRT6_DBL_SYNC_IN
.set BOTTOM_4__PRTDSI__OE_SEL0, CYREG_PRT6_OE_SEL0
.set BOTTOM_4__PRTDSI__OE_SEL1, CYREG_PRT6_OE_SEL1
.set BOTTOM_4__PRTDSI__OUT_SEL0, CYREG_PRT6_OUT_SEL0
.set BOTTOM_4__PRTDSI__OUT_SEL1, CYREG_PRT6_OUT_SEL1
.set BOTTOM_4__PRTDSI__SYNC_OUT, CYREG_PRT6_SYNC_OUT
.set BOTTOM_4__PS, CYREG_PRT6_PS
.set BOTTOM_4__SHIFT, 3
.set BOTTOM_4__SLW, CYREG_PRT6_SLW

/* rx_int */
.set rx_int__INTC_CLR_EN_REG, CYREG_NVIC_CLRENA0
.set rx_int__INTC_CLR_PD_REG, CYREG_NVIC_CLRPEND0
.set rx_int__INTC_MASK, 0x02
.set rx_int__INTC_NUMBER, 1
.set rx_int__INTC_PRIOR_NUM, 7
.set rx_int__INTC_PRIOR_REG, CYREG_NVIC_PRI_1
.set rx_int__INTC_SET_EN_REG, CYREG_NVIC_SETENA0
.set rx_int__INTC_SET_PD_REG, CYREG_NVIC_SETPEND0

/* tx_int */
.set tx_int__INTC_CLR_EN_REG, CYREG_NVIC_CLRENA0
.set tx_int__INTC_CLR_PD_REG, CYREG_NVIC_CLRPEND0
.set tx_int__INTC_MASK, 0x04
.set tx_int__INTC_NUMBER, 2
.set tx_int__INTC_PRIOR_NUM, 7
.set tx_int__INTC_PRIOR_REG, CYREG_NVIC_PRI_2
.set tx_int__INTC_SET_EN_REG, CYREG_NVIC_SETENA0
.set tx_int__INTC_SET_PD_REG, CYREG_NVIC_SETPEND0

/* TOP_1 */
.set TOP_1__0__MASK, 0x40
.set TOP_1__0__PC, CYREG_PRT1_PC6
.set TOP_1__0__PORT, 1
.set TOP_1__0__SHIFT, 6
.set TOP_1__AG, CYREG_PRT1_AG
.set TOP_1__AMUX, CYREG_PRT1_AMUX
.set TOP_1__BIE, CYREG_PRT1_BIE
.set TOP_1__BIT_MASK, CYREG_PRT1_BIT_MASK
.set TOP_1__BYP, CYREG_PRT1_BYP
.set TOP_1__CTL, CYREG_PRT1_CTL
.set TOP_1__DM0, CYREG_PRT1_DM0
.set TOP_1__DM1, CYREG_PRT1_DM1
.set TOP_1__DM2, CYREG_PRT1_DM2
.set TOP_1__DR, CYREG_PRT1_DR
.set TOP_1__INP_DIS, CYREG_PRT1_INP_DIS
.set TOP_1__LCD_COM_SEG, CYREG_PRT1_LCD_COM_SEG
.set TOP_1__LCD_EN, CYREG_PRT1_LCD_EN
.set TOP_1__MASK, 0x40
.set TOP_1__PORT, 1
.set TOP_1__PRT, CYREG_PRT1_PRT
.set TOP_1__PRTDSI__CAPS_SEL, CYREG_PRT1_CAPS_SEL
.set TOP_1__PRTDSI__DBL_SYNC_IN, CYREG_PRT1_DBL_SYNC_IN
.set TOP_1__PRTDSI__OE_SEL0, CYREG_PRT1_OE_SEL0
.set TOP_1__PRTDSI__OE_SEL1, CYREG_PRT1_OE_SEL1
.set TOP_1__PRTDSI__OUT_SEL0, CYREG_PRT1_OUT_SEL0
.set TOP_1__PRTDSI__OUT_SEL1, CYREG_PRT1_OUT_SEL1
.set TOP_1__PRTDSI__SYNC_OUT, CYREG_PRT1_SYNC_OUT
.set TOP_1__PS, CYREG_PRT1_PS
.set TOP_1__SHIFT, 6
.set TOP_1__SLW, CYREG_PRT1_SLW

/* TOP_2 */
.set TOP_2__0__MASK, 0x10
.set TOP_2__0__PC, CYREG_PRT5_PC4
.set TOP_2__0__PORT, 5
.set TOP_2__0__SHIFT, 4
.set TOP_2__AG, CYREG_PRT5_AG
.set TOP_2__AMUX, CYREG_PRT5_AMUX
.set TOP_2__BIE, CYREG_PRT5_BIE
.set TOP_2__BIT_MASK, CYREG_PRT5_BIT_MASK
.set TOP_2__BYP, CYREG_PRT5_BYP
.set TOP_2__CTL, CYREG_PRT5_CTL
.set TOP_2__DM0, CYREG_PRT5_DM0
.set TOP_2__DM1, CYREG_PRT5_DM1
.set TOP_2__DM2, CYREG_PRT5_DM2
.set TOP_2__DR, CYREG_PRT5_DR
.set TOP_2__INP_DIS, CYREG_PRT5_INP_DIS
.set TOP_2__LCD_COM_SEG, CYREG_PRT5_LCD_COM_SEG
.set TOP_2__LCD_EN, CYREG_PRT5_LCD_EN
.set TOP_2__MASK, 0x10
.set TOP_2__PORT, 5
.set TOP_2__PRT, CYREG_PRT5_PRT
.set TOP_2__PRTDSI__CAPS_SEL, CYREG_PRT5_CAPS_SEL
.set TOP_2__PRTDSI__DBL_SYNC_IN, CYREG_PRT5_DBL_SYNC_IN
.set TOP_2__PRTDSI__OE_SEL0, CYREG_PRT5_OE_SEL0
.set TOP_2__PRTDSI__OE_SEL1, CYREG_PRT5_OE_SEL1
.set TOP_2__PRTDSI__OUT_SEL0, CYREG_PRT5_OUT_SEL0
.set TOP_2__PRTDSI__OUT_SEL1, CYREG_PRT5_OUT_SEL1
.set TOP_2__PRTDSI__SYNC_OUT, CYREG_PRT5_SYNC_OUT
.set TOP_2__PS, CYREG_PRT5_PS
.set TOP_2__SHIFT, 4
.set TOP_2__SLW, CYREG_PRT5_SLW

/* TOP_3 */
.set TOP_3__0__MASK, 0x01
.set TOP_3__0__PC, CYREG_PRT3_PC0
.set TOP_3__0__PORT, 3
.set TOP_3__0__SHIFT, 0
.set TOP_3__AG, CYREG_PRT3_AG
.set TOP_3__AMUX, CYREG_PRT3_AMUX
.set TOP_3__BIE, CYREG_PRT3_BIE
.set TOP_3__BIT_MASK, CYREG_PRT3_BIT_MASK
.set TOP_3__BYP, CYREG_PRT3_BYP
.set TOP_3__CTL, CYREG_PRT3_CTL
.set TOP_3__DM0, CYREG_PRT3_DM0
.set TOP_3__DM1, CYREG_PRT3_DM1
.set TOP_3__DM2, CYREG_PRT3_DM2
.set TOP_3__DR, CYREG_PRT3_DR
.set TOP_3__INP_DIS, CYREG_PRT3_INP_DIS
.set TOP_3__LCD_COM_SEG, CYREG_PRT3_LCD_COM_SEG
.set TOP_3__LCD_EN, CYREG_PRT3_LCD_EN
.set TOP_3__MASK, 0x01
.set TOP_3__PORT, 3
.set TOP_3__PRT, CYREG_PRT3_PRT
.set TOP_3__PRTDSI__CAPS_SEL, CYREG_PRT3_CAPS_SEL
.set TOP_3__PRTDSI__DBL_SYNC_IN, CYREG_PRT3_DBL_SYNC_IN
.set TOP_3__PRTDSI__OE_SEL0, CYREG_PRT3_OE_SEL0
.set TOP_3__PRTDSI__OE_SEL1, CYREG_PRT3_OE_SEL1
.set TOP_3__PRTDSI__OUT_SEL0, CYREG_PRT3_OUT_SEL0
.set TOP_3__PRTDSI__OUT_SEL1, CYREG_PRT3_OUT_SEL1
.set TOP_3__PRTDSI__SYNC_OUT, CYREG_PRT3_SYNC_OUT
.set TOP_3__PS, CYREG_PRT3_PS
.set TOP_3__SHIFT, 0
.set TOP_3__SLW, CYREG_PRT3_SLW

/* TOP_4 */
.set TOP_4__0__MASK, 0x04
.set TOP_4__0__PC, CYREG_PRT4_PC2
.set TOP_4__0__PORT, 4
.set TOP_4__0__SHIFT, 2
.set TOP_4__AG, CYREG_PRT4_AG
.set TOP_4__AMUX, CYREG_PRT4_AMUX
.set TOP_4__BIE, CYREG_PRT4_BIE
.set TOP_4__BIT_MASK, CYREG_PRT4_BIT_MASK
.set TOP_4__BYP, CYREG_PRT4_BYP
.set TOP_4__CTL, CYREG_PRT4_CTL
.set TOP_4__DM0, CYREG_PRT4_DM0
.set TOP_4__DM1, CYREG_PRT4_DM1
.set TOP_4__DM2, CYREG_PRT4_DM2
.set TOP_4__DR, CYREG_PRT4_DR
.set TOP_4__INP_DIS, CYREG_PRT4_INP_DIS
.set TOP_4__LCD_COM_SEG, CYREG_PRT4_LCD_COM_SEG
.set TOP_4__LCD_EN, CYREG_PRT4_LCD_EN
.set TOP_4__MASK, 0x04
.set TOP_4__PORT, 4
.set TOP_4__PRT, CYREG_PRT4_PRT
.set TOP_4__PRTDSI__CAPS_SEL, CYREG_PRT4_CAPS_SEL
.set TOP_4__PRTDSI__DBL_SYNC_IN, CYREG_PRT4_DBL_SYNC_IN
.set TOP_4__PRTDSI__OE_SEL0, CYREG_PRT4_OE_SEL0
.set TOP_4__PRTDSI__OE_SEL1, CYREG_PRT4_OE_SEL1
.set TOP_4__PRTDSI__OUT_SEL0, CYREG_PRT4_OUT_SEL0
.set TOP_4__PRTDSI__OUT_SEL1, CYREG_PRT4_OUT_SEL1
.set TOP_4__PRTDSI__SYNC_OUT, CYREG_PRT4_SYNC_OUT
.set TOP_4__PS, CYREG_PRT4_PS
.set TOP_4__SHIFT, 2
.set TOP_4__SLW, CYREG_PRT4_SLW

/* RX */
.set RX__0__MASK, 0x01
.set RX__0__PC, CYREG_PRT6_PC0
.set RX__0__PORT, 6
.set RX__0__SHIFT, 0
.set RX__AG, CYREG_PRT6_AG
.set RX__AMUX, CYREG_PRT6_AMUX
.set RX__BIE, CYREG_PRT6_BIE
.set RX__BIT_MASK, CYREG_PRT6_BIT_MASK
.set RX__BYP, CYREG_PRT6_BYP
.set RX__CTL, CYREG_PRT6_CTL
.set RX__DM0, CYREG_PRT6_DM0
.set RX__DM1, CYREG_PRT6_DM1
.set RX__DM2, CYREG_PRT6_DM2
.set RX__DR, CYREG_PRT6_DR
.set RX__INP_DIS, CYREG_PRT6_INP_DIS
.set RX__LCD_COM_SEG, CYREG_PRT6_LCD_COM_SEG
.set RX__LCD_EN, CYREG_PRT6_LCD_EN
.set RX__MASK, 0x01
.set RX__PORT, 6
.set RX__PRT, CYREG_PRT6_PRT
.set RX__PRTDSI__CAPS_SEL, CYREG_PRT6_CAPS_SEL
.set RX__PRTDSI__DBL_SYNC_IN, CYREG_PRT6_DBL_SYNC_IN
.set RX__PRTDSI__OE_SEL0, CYREG_PRT6_OE_SEL0
.set RX__PRTDSI__OE_SEL1, CYREG_PRT6_OE_SEL1
.set RX__PRTDSI__OUT_SEL0, CYREG_PRT6_OUT_SEL0
.set RX__PRTDSI__OUT_SEL1, CYREG_PRT6_OUT_SEL1
.set RX__PRTDSI__SYNC_OUT, CYREG_PRT6_SYNC_OUT
.set RX__PS, CYREG_PRT6_PS
.set RX__SHIFT, 0
.set RX__SLW, CYREG_PRT6_SLW

/* TX */
.set TX__0__MASK, 0x40
.set TX__0__PC, CYREG_PRT6_PC6
.set TX__0__PORT, 6
.set TX__0__SHIFT, 6
.set TX__AG, CYREG_PRT6_AG
.set TX__AMUX, CYREG_PRT6_AMUX
.set TX__BIE, CYREG_PRT6_BIE
.set TX__BIT_MASK, CYREG_PRT6_BIT_MASK
.set TX__BYP, CYREG_PRT6_BYP
.set TX__CTL, CYREG_PRT6_CTL
.set TX__DM0, CYREG_PRT6_DM0
.set TX__DM1, CYREG_PRT6_DM1
.set TX__DM2, CYREG_PRT6_DM2
.set TX__DR, CYREG_PRT6_DR
.set TX__INP_DIS, CYREG_PRT6_INP_DIS
.set TX__LCD_COM_SEG, CYREG_PRT6_LCD_COM_SEG
.set TX__LCD_EN, CYREG_PRT6_LCD_EN
.set TX__MASK, 0x40
.set TX__PORT, 6
.set TX__PRT, CYREG_PRT6_PRT
.set TX__PRTDSI__CAPS_SEL, CYREG_PRT6_CAPS_SEL
.set TX__PRTDSI__DBL_SYNC_IN, CYREG_PRT6_DBL_SYNC_IN
.set TX__PRTDSI__OE_SEL0, CYREG_PRT6_OE_SEL0
.set TX__PRTDSI__OE_SEL1, CYREG_PRT6_OE_SEL1
.set TX__PRTDSI__OUT_SEL0, CYREG_PRT6_OUT_SEL0
.set TX__PRTDSI__OUT_SEL1, CYREG_PRT6_OUT_SEL1
.set TX__PRTDSI__SYNC_OUT, CYREG_PRT6_SYNC_OUT
.set TX__PS, CYREG_PRT6_PS
.set TX__SHIFT, 6
.set TX__SLW, CYREG_PRT6_SLW

/* Miscellaneous */
/* -- WARNING: define names containing LEOPARD or PANTHER are deprecated and will be removed in a future release */
.set CYDEV_DEBUGGING_DPS_SWD_SWV, 6
.set CYDEV_CONFIG_UNUSED_IO_AllowButWarn, 0
.set CYDEV_CONFIGURATION_MODE_COMPRESSED, 0
.set CYDEV_CONFIG_FASTBOOT_ENABLED, 1
.set CYDEV_CHIP_REV_PSOC5LP_PRODUCTION, 0
.set CYDEV_CHIP_REVISION_5B_PRODUCTION, 0
.set CYDEV_CHIP_MEMBER_5B, 3
.set CYDEV_CHIP_FAMILY_PSOC5, 3
.set CYDEV_CHIP_DIE_PSOC5LP, 3
.set CYDEV_CHIP_DIE_EXPECT, CYDEV_CHIP_DIE_PSOC5LP
.set BCLK__BUS_CLK__HZ, 24000000
.set BCLK__BUS_CLK__KHZ, 24000
.set BCLK__BUS_CLK__MHZ, 24
.set CYDEV_CHIP_DIE_ACTUAL, CYDEV_CHIP_DIE_EXPECT
.set CYDEV_CHIP_DIE_LEOPARD, 1
.set CYDEV_CHIP_DIE_PANTHER, 2
.set CYDEV_CHIP_DIE_UNKNOWN, 0
.set CYDEV_CHIP_FAMILY_PSOC3, 1
.set CYDEV_CHIP_FAMILY_PSOC4, 2
.set CYDEV_CHIP_FAMILY_UNKNOWN, 0
.set CYDEV_CHIP_FAMILY_USED, CYDEV_CHIP_FAMILY_PSOC5
.set CYDEV_CHIP_JTAG_ID, 0x2E123069
.set CYDEV_CHIP_MEMBER_3A, 1
.set CYDEV_CHIP_MEMBER_5A, 2
.set CYDEV_CHIP_MEMBER_UNKNOWN, 0
.set CYDEV_CHIP_MEMBER_USED, CYDEV_CHIP_MEMBER_5B
.set CYDEV_CHIP_REVISION_3A_ES1, 0
.set CYDEV_CHIP_REVISION_3A_ES2, 1
.set CYDEV_CHIP_REVISION_3A_ES3, 3
.set CYDEV_CHIP_REVISION_3A_PRODUCTION, 3
.set CYDEV_CHIP_REVISION_5A_ES0, 0
.set CYDEV_CHIP_REVISION_5A_ES1, 1
.set CYDEV_CHIP_REVISION_5A_PRODUCTION, 1
.set CYDEV_CHIP_REVISION_5B_ES, 0
.set CYDEV_CHIP_REVISION_USED, CYDEV_CHIP_REVISION_5B_PRODUCTION
.set CYDEV_CHIP_REV_EXPECT, CYDEV_CHIP_REV_PSOC5LP_PRODUCTION
.set CYDEV_CHIP_REV_LEOPARD_ES1, 0
.set CYDEV_CHIP_REV_LEOPARD_ES2, 1
.set CYDEV_CHIP_REV_LEOPARD_ES3, 3
.set CYDEV_CHIP_REV_LEOPARD_PRODUCTION, 3
.set CYDEV_CHIP_REV_PANTHER_ES0, 0
.set CYDEV_CHIP_REV_PANTHER_ES1, 1
.set CYDEV_CHIP_REV_PANTHER_PRODUCTION, 1
.set CYDEV_CHIP_REV_PSOC5LP_ES, 0
.set CYDEV_CONFIGURATION_COMPRESSED, 1
.set CYDEV_CONFIGURATION_DMA, 0
.set CYDEV_CONFIGURATION_ECC, 1
.set CYDEV_CONFIGURATION_IMOENABLED, CYDEV_CONFIG_FASTBOOT_ENABLED
.set CYDEV_CONFIGURATION_MODE, CYDEV_CONFIGURATION_MODE_COMPRESSED
.set CYDEV_CONFIGURATION_MODE_DMA, 2
.set CYDEV_CONFIGURATION_MODE_UNCOMPRESSED, 1
.set CYDEV_CONFIG_FORCE_ROUTE, 0
.set CYDEV_CONFIG_UNUSED_IO, CYDEV_CONFIG_UNUSED_IO_AllowButWarn
.set CYDEV_CONFIG_UNUSED_IO_AllowWithInfo, 1
.set CYDEV_CONFIG_UNUSED_IO_Disallowed, 2
.set CYDEV_DEBUGGING_DPS, CYDEV_DEBUGGING_DPS_SWD_SWV
.set CYDEV_DEBUGGING_DPS_Disable, 3
.set CYDEV_DEBUGGING_DPS_JTAG_4, 1
.set CYDEV_DEBUGGING_DPS_JTAG_5, 0
.set CYDEV_DEBUGGING_DPS_SWD, 2
.set CYDEV_DEBUGGING_ENABLE, 1
.set CYDEV_DEBUGGING_REQXRES, 1
.set CYDEV_DEBUGGING_XRES, 0
.set CYDEV_DEBUG_ENABLE_MASK, 0x20
.set CYDEV_DEBUG_ENABLE_REGISTER, CYREG_MLOGIC_DEBUG
.set CYDEV_DMA_CHANNELS_AVAILABLE, 24
.set CYDEV_ECC_ENABLE, 0
.set CYDEV_HEAP_SIZE, 0x1000
.set CYDEV_INSTRUCT_CACHE_ENABLED, 1
.set CYDEV_PROJ_TYPE, 0
.set CYDEV_PROJ_TYPE_BOOTLOADER, 1
.set CYDEV_PROJ_TYPE_LOADABLE, 2
.set CYDEV_PROJ_TYPE_MULTIAPPBOOTLOADER, 3
.set CYDEV_PROJ_TYPE_STANDARD, 0
.set CYDEV_PROTECTION_ENABLE, 0
.set CYDEV_STACK_SIZE, 0x4000
.set CYDEV_VDDA_MV, 5000
.set CYDEV_VDDD_MV, 5000
.set CYDEV_VDDIO0_MV, 5000
.set CYDEV_VDDIO1_MV, 5000
.set CYDEV_VDDIO2_MV, 5000
.set CYDEV_VDDIO3_MV, 5000
.set CYDEV_VIO0, 5
.set CYDEV_VIO0_MV, 5000
.set CYDEV_VIO1, 5
.set CYDEV_VIO1_MV, 5000
.set CYDEV_VIO2, 5
.set CYDEV_VIO2_MV, 5000
.set CYDEV_VIO3, 5
.set CYDEV_VIO3_MV, 5000
.set DMA_CHANNELS_USED__MASK0, 0x00000000
.set CYDEV_BOOTLOADER_ENABLE, 0
.endif
